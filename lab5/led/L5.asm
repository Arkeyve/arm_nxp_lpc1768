    AREA RESET,DATA,READONLY
	EXPORT __Vectors
__Vectors
    DCD 0X40001000;
	DCD Reset_Handler
	ALIGN
	area mycode,CODE,READONLY

	ENTRY
	EXPORT Reset_Handler
Reset_Handler
	LDR R0,=0X9
	LDR R1,=0X12
	SUB R1,#1
	MOV R12,R0
    LDR R8,=0X20000000
UP2 CMP R1,#0
	BEQ DOWN
	MOV R3,#8
	
UP  AND R4,R0,#0X0F
	AND R5,R0,#0X0F
	MSR XPSR,R7
	ADCS R6,R4,R5
	BL CONV
	ROR R9,#4
	ROR R0,#4
	SUB R3,#1
	CMP R3,#0
	BNE UP
	MOV R7,#00
	MOV R12,R9
	MOV R9,#00
	SUB R1,#1
	B UP2
DOWN 
	LDR R9,=DST
	STR R12,[R9]
STOP 
	B STOP
CONV MOV R8,R6
	AND R6,#0X0F
	CMP R6,#0X09
	BLS SKIP
	ADD R6,#06
	B DOWN1
SKIP MOV R6,R8
	AND R6,#0X1F
	CMP R6,#10
	ADDHS R6,#06
DOWN1 AND R11,R6,#0X0F
	ORR R9,R11
	MOV R7,#00
	AND R7,R6,#0X10
	LSL R7,#25
	BX LR
	AREA DATASEG,DATA,READWRITE
DST DCD 0
  END
	